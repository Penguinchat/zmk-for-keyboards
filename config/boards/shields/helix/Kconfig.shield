## config/boards/shields/helix/Kconfig.shield
```kconfig
# Copyright (c) 2020 The ZMK Contributors
# SPDX-License-Identifier: MIT

config SHIELD_HELIX_CENTRAL_DONGLE
    def_bool $(shields_list_contains,helix_central_dongle)

config SHIELD_HELIX_PERIPHERAL_LEFT
    def_bool $(shields_list_contains,helix_peripheral_left)

config SHIELD_HELIX_PERIPHERAL_RIGHT
    def_bool $(shields_list_contains,helix_peripheral_right)
```

## config/boards/shields/lily58/Kconfig.defconfig
```kconfig
if SHIELD_LILY58_LEFT

config ZMK_KEYBOARD_NAME
    default "Lily58"

config ZMK_SPLIT_ROLE_CENTRAL
    default y

endif

if SHIELD_LILY58_LEFT || SHIELD_LILY58_RIGHT

config ZMK_SPLIT
    default y

if ZMK_DISPLAY

config I2C
    default y

config SSD1306
    default y

endif # ZMK_DISPLAY

if LVGL

config LV_Z_VDB_SIZE
    default 64

config LV_DPI_DEF
    default 148

config LV_Z_BITS_PER_PIXEL
    default 1

choice LV_COLOR_DEPTH
    default LV_COLOR_DEPTH_1
endchoice

endif # LVGL

endif
config ZMK_RGB_UNDERGLOW_EFF_START
    int "Default RGB underglow effect on startup"
    default 0
    range 0 UNDERGLOW_EFFECT_NUMBER-1
    help
      The default effect for RGB underglow when the keyboard starts.
      0: Solid
      1: Breathe
      2: Spectrum
      3: Swirl
      4: Rainbow
      5: Double Bird
```

## config/boards/shields/lily58/Kconfig.shield
```kconfig
# Copyright (c) 2020 The ZMK Contributors
# SPDX-License-Identifier: MIT

config SHIELD_LILY58_CENTRAL_DONGLE
    def_bool $(shields_list_contains,lily58_central_dongle)

config SHIELD_LILY58_PERIPHERAL_LEFT
    def_bool $(shields_list_contains,lily58_peripheral_left)

config SHIELD_LILY58_PERIPHERAL_RIGHT
    def_bool $(shields_list_contains,lily58_peripheral_right)
```
